#include "my_gc9a01.h"
#include "driver/spi_master.h"
#include "esp_heap_caps.h"
#include "esp_lcd_panel_io.h"  // 必须引入 IO 层操作
#include "esp_lcd_panel_ops.h" // 必须引入 Panel 绘制/控制操作
#include <stdio.h>
#include "esp_log.h"


// 5x8 ASCII font table (32-126)
static const uint8_t ascii_font_5x8[][5] = {
    { 0x00, 0x00, 0x00, 0x00, 0x00 }, // space
    { 0x00, 0x00, 0x5F, 0x00, 0x00 }, // !
    { 0x00, 0x07, 0x00, 0x07, 0x00 }, // "
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    { 0x08, 0x04, 0x08, 0x10, 0x08 }, // ~
};

// 全局变量
static esp_lcd_panel_handle_t panel_handle;

// RGB565 byte swap (little-endian to big-endian)
static inline uint16_t rgb565_swap(uint16_t v)
{
    return (uint16_t)((v << 8) | (v >> 8));
}

// 内部函数声明
static void init_spi_bus(void);
static void init_lcd_io(void);
static void init_panel(void);

// 统合初始化函数 (供 main.cc 调用)
void my_gc9a01_init(void)
{
    init_spi_bus();
    init_lcd_io();
    init_panel();
    printf("GC9A01 Initialization completed.\n");
}

// 初始化 SPI 总线
static void init_spi_bus(void)
{
    spi_bus_config_t buscfg = GC9A01_PANEL_BUS_SPI_CONFIG(PIN_NUM_SCLK, PIN_NUM_MOSI, LCD_H_RES * LCD_V_RES * 2);
    ESP_ERROR_CHECK(spi_bus_initialize(LCD_HOST, &buscfg, SPI_DMA_CH_AUTO));
}

// 初始化 LCD IO 接口
static void init_lcd_io(void)
{
    esp_lcd_panel_io_handle_t io_handle;
    esp_lcd_panel_io_spi_config_t io_config = GC9A01_PANEL_IO_SPI_CONFIG(PIN_NUM_CS, PIN_NUM_DC, NULL, NULL);
    ESP_ERROR_CHECK(esp_lcd_new_panel_io_spi((esp_lcd_spi_bus_handle_t)LCD_HOST, &io_config, &io_handle));

    // 创建 GC9A01 面板实例
    esp_lcd_panel_dev_config_t panel_config = {
        .reset_gpio_num = PIN_NUM_RST,
        .rgb_endian = LCD_RGB_ENDIAN_BGR, // 如果显示颜色颠倒，可以尝试改成 LCD_RGB_ENDIAN_BGR
        .bits_per_pixel = 16, //一个像素占用16bit,即2个字节
        .vendor_config = NULL,
    };
    ESP_ERROR_CHECK(esp_lcd_new_panel_gc9a01(io_handle, &panel_config, &panel_handle));
}

// 初始化面板
static void init_panel(void)
{
    ESP_ERROR_CHECK(esp_lcd_panel_reset(panel_handle));
    ESP_ERROR_CHECK(esp_lcd_panel_init(panel_handle));
    
    //解决 IPS 屏幕的颜色反转问题
    ESP_ERROR_CHECK(esp_lcd_panel_invert_color(panel_handle, true));

    //解决显示镜像问题
    ESP_ERROR_CHECK(esp_lcd_panel_mirror(panel_handle, true, false));

    // 关键修正：开启显示，否则屏幕默认黑屏
    ESP_ERROR_CHECK(esp_lcd_panel_disp_on_off(panel_handle, true));
}

// 绘制简单图形进行测试
void my_gc9a01_test_display(void)
{
    uint16_t color = 0xF800; // 测试红色 (RGB565格式)
    
    // GC9A01 是圆屏，分配整屏显存需要注意内存大小
    uint16_t *buffer = (uint16_t *)heap_caps_malloc(LCD_H_RES * LCD_V_RES * sizeof(uint16_t), MALLOC_CAP_DMA);
    if (!buffer) {
        printf("Failed to allocate frame buffer\n");
        return;
    }

    // 填充整个屏幕为红色
    for (int i = 0; i < LCD_H_RES * LCD_V_RES; i++) {
        buffer[i] = color;
    }

    // 绘制到屏幕上
    esp_lcd_panel_draw_bitmap(panel_handle, 0, 0, LCD_H_RES, LCD_V_RES, buffer);

    free(buffer);
    printf("Display test completed (Screen should be RED).\n");
}

// 在 my_gc9a01.c 中新增函数
void my_gc9a01_draw_char(int16_t x, int16_t y, char c, uint16_t color)
{
    if (c < 32 || c > 126)
    {
       printf("超出范围\n");
       return; // 只支持可打印 ASCII 
    }

    const uint8_t *glyph = ascii_font_5x8[c - 32];
    uint16_t *buffer = heap_caps_malloc(5 * 8 * sizeof(uint16_t), MALLOC_CAP_DMA);
    if (!buffer) return;

    // Convert 1bpp font (5 columns x 8 rows) to RGB565 pixels
    const uint16_t fg = rgb565_swap(color);
    const uint16_t background = rgb565_swap(GC9A01_WHITE);
    for (int row = 0; row < 8; row++) {
        for (int col = 0; col < 5; col++) {
            bool on = (glyph[col] & (1 << row)) != 0;
            buffer[row * 5 + col] = on ? fg : background;
        }
    }

    esp_lcd_panel_draw_bitmap(panel_handle, x, y, x + 5, y + 8, buffer);
    free(buffer);
}

void my_gc9a01_draw_string(int16_t x, int16_t y, const char *str, uint16_t color)
{
    while (*str) {
        my_gc9a01_draw_char(x, y, *str++, color);
        x += 6; // 字符间距
    }
}

// 清屏函数：用指定颜色填充整个屏幕
void my_gc9a01_clear_screen(uint16_t color)
{
    // 分配整屏显存（注意：GC9A01 是圆形屏，但通常按矩形区域操作）
    uint16_t *buffer = (uint16_t *)heap_caps_malloc(LCD_H_RES * LCD_V_RES * sizeof(uint16_t), MALLOC_CAP_DMA);
    if (!buffer) {
        ESP_LOGE("GC9A01", "Failed to allocate buffer for clear screen");
        return;
    }

    // 填充整个缓冲区为指定颜色
    uint16_t swapped = rgb565_swap(color);
    for (int i = 0; i < LCD_H_RES * LCD_V_RES; i++) {
        buffer[i] = swapped;
    }

    // 刷新到屏幕
    esp_lcd_panel_draw_bitmap(panel_handle, 0, 0, LCD_H_RES, LCD_V_RES, buffer);

    free(buffer);
}

// 清除指定行范围（y_start 到 y_end，包含）
void my_gc9a01_clear_lines(int16_t y_start, int16_t y_end, uint16_t color)
{
    if (y_start < 0) y_start = 0;
    if (y_end >= LCD_V_RES) y_end = LCD_V_RES - 1;
    if (y_start > y_end) return;

    int height = y_end - y_start + 1;
    uint16_t *buffer = (uint16_t *)heap_caps_malloc(LCD_H_RES * height * sizeof(uint16_t), MALLOC_CAP_DMA);
    if (!buffer) {
        ESP_LOGE("GC9A01", "Failed to allocate buffer for clear lines");
        return;
    }

    // 填充缓冲区为指定颜色
    uint16_t swapped = rgb565_swap(color);
    for (int i = 0; i < LCD_H_RES * height; i++) {
        buffer[i] = swapped;
    }

    // 刷新指定区域
    esp_lcd_panel_draw_bitmap(panel_handle, 0, y_start, LCD_H_RES, y_end + 1, buffer);

    free(buffer);
}

// 提供给调用的区域刷新函数
void my_gc9a01_draw_bitmap(int x_start, int y_start, int x_end, int y_end, const void *color_data)
{
    // 直接调用 esp_lcd 现成的 DMA 刷屏接口
    // 如果你的 color_data 已经是高字节在前的格式，请在调用前自己处理
    esp_lcd_panel_draw_bitmap(panel_handle, x_start, y_start, x_end, y_end, color_data);
}
